## source/thead_rvv/Kconfig
```kconfig
menu "RISC-V V extension optimization"

config THEAD_RVV_SOURCE
	bool "SHL RISC-V V extension optimization code"
	default y
	help
		Select SHL build RISC-V V extension optimization

config THEAD_RVV_ADD_FP32
	depends on THEAD_RVV_SOURCE
	bool "Layer add fp32"
	default y
	help
		Select SHL build v extension optimized add

config THEAD_RVV_ADD_FP16
	depends on THEAD_RVV_SOURCE
	bool "Layer add fp16"
	default y
	help
		Select SHL build v extension optimized add

config THEAD_RVV_ADD_INT8
	depends on THEAD_RVV_SOURCE
	bool "Layer add int8"
	default y
	help
		Select SHL build v extension optimized add

config THEAD_RVV_AVERAGEPOOL_FP32
	depends on THEAD_RVV_SOURCE
	bool "Layer averagepool fp32"
	default y
	help
		Select SHL build v extension optimized averagepool

config THEAD_RVV_AVERAGEPOOL_FP16
	depends on THEAD_RVV_SOURCE
	bool "Layer averagepool fp16"
	default y
	help
		Select SHL build v extension optimized averagepool

config THEAD_RVV_AVERAGEPOOL_INT8
	depends on THEAD_RVV_SOURCE
	bool "Layer averagepool int8"
	default y
	help
		Select SHL build v extension optimized averagepool

config THEAD_RVV_CLIP_FP32
	depends on THEAD_RVV_SOURCE
	bool "Layer clip fp32"
	default y
	help
		Select SHL build v extension optimized clip

config THEAD_RVV_CLIP_FP16
	depends on THEAD_RVV_SOURCE
	bool "Layer clip fp16"
	default y
	help
		Select SHL build v extension optimized clip

config THEAD_RVV_CLIP_INT8
	depends on THEAD_RVV_SOURCE
	bool "Layer clip int8"
	default y
	help
		Select SHL build v extension optimized clip

config THEAD_RVV_CONCAT_FP32
	depends on THEAD_RVV_SOURCE
	bool "Layer concat fp32"
	default y
	help
		Select SHL build v extension optimized concat

config THEAD_RVV_CONCAT_FP16
	depends on THEAD_RVV_SOURCE
	bool "Layer concat fp16"
	default y
	help
		Select SHL build v extension optimized concat

config THEAD_RVV_CONCAT_INT8
	depends on THEAD_RVV_SOURCE
	bool "Layer concat int8"
	default y
	help
		Select SHL build v extension optimized concat

config THEAD_RVV_CONVOLUTION_FP32
	depends on THEAD_RVV_SOURCE
	bool "Layer convolution fp32"
	default y
	help
		Select SHL build v extension optimized convolution

config THEAD_RVV_CONVOLUTION_FP16
	depends on THEAD_RVV_SOURCE
	bool "Layer convolution fp16"
	default y
	help
		Select SHL build v extension optimized convolution

config THEAD_RVV_CONVOLUTION_INT8
	depends on THEAD_RVV_SOURCE
	bool "Layer convolution int8"
	default y
	help
		Select SHL build v extension optimized convolution

config THEAD_RVV_CONVOLUTION_INT4
	depends on THEAD_RVV_SOURCE
	bool "Layer convolution int4"
	default y
	help
		Select SHL build v extension optimized convolution

config THEAD_RVV_DEPTHWISE_CONVOLUTION_FP32
	depends on THEAD_RVV_SOURCE
	bool "Layer depthwise convolution fp32"
	default y
	help
		Select SHL build v extension optimized convolution

config THEAD_RVV_DEPTHWISE_CONVOLUTION_FP16
	depends on THEAD_RVV_SOURCE
	bool "Layer depthwise convolution fp16"
	default y
	help
		Select SHL build v extension optimized convolution

config THEAD_RVV_DEPTHWISE_CONVOLUTION_INT8
	depends on THEAD_RVV_SOURCE
	bool "Layer depthwise convolution int8"
	default y
	help
		Select SHL build v extension optimized convolution

config THEAD_RVV_DEPTHWISE_CONVOLUTION_INT4
	depends on THEAD_RVV_SOURCE
	bool "Layer depthwise convolution int4"
	default y
	help
		Select SHL build v extension optimized convolution

config THEAD_RVV_CONVOLUTION1D_INT8
	depends on THEAD_RVV_SOURCE
	bool "Layer convolution1d int8"
	default y
	help
		Select SHL build v extension optimized convolution1d

config THEAD_RVV_DEPTHWISE_CONVOLUTION1D_INT8
	depends on THEAD_RVV_SOURCE
	bool "Layer depthwise convolution1d int8"
	default y
	help
		Select SHL build v extension optimized convolution1d

config THEAD_RVV_FULLYCONNECTED_FP32
	depends on THEAD_RVV_SOURCE
	bool "Layer fullyconnected fp32"
	default y
	help
		Select SHL build v extension optimized fullyconnected

config THEAD_RVV_FULLYCONNECTED_FP16
	depends on THEAD_RVV_SOURCE
	bool "Layer fullyconnected fp16"
	default y
	help
		Select SHL build v extension optimized fullyconnected

config THEAD_RVV_FULLYCONNECTED_INT8
	depends on THEAD_RVV_SOURCE
	bool "Layer fullyconnected int8"
	default y
	help
		Select SHL build v extension optimized fullyconnected

config THEAD_RVV_FULLYCONNECTED_INT4
	depends on THEAD_RVV_SOURCE
	bool "Layer fullyconnected int4"
	default y
	help
		Select SHL build v extension optimized fullyconnected

config THEAD_RVV_GEMM_FP32
	depends on THEAD_RVV_SOURCE
	bool "Layer GEMM fp32"
	default y
	help
		Select SHL build v extension optimized fullyconnected

config THEAD_RVV_GEMM_FP16
	depends on THEAD_RVV_SOURCE
	bool "Layer GEMM fp16"
	default y
	help
		Select SHL build v extension optimized fullyconnected

config THEAD_RVV_GEMM_INT8
	depends on THEAD_RVV_SOURCE
	bool "Layer GEMM int8"
	default y
	help
		Select SHL build v extension optimized fullyconnected

config THEAD_RVV_GEMM_INT4
	depends on THEAD_RVV_SOURCE
	bool "Layer GEMM int4"
	default y
	help
		Select SHL build v extension optimized fullyconnected

config THEAD_RVV_GLOBAL_AVERAGEPOOL_FP32
	depends on THEAD_RVV_SOURCE
	bool "Layer global_averagepool fp32"
	default y
	help
		Select SHL build v extension optimized global_averagepool

config THEAD_RVV_GLOBAL_AVERAGEPOOL_FP16
	depends on THEAD_RVV_SOURCE
	bool "Layer global_averagepool fp16"
	default y
	help
		Select SHL build v extension optimized global_averagepool

config THEAD_RVV_GLOBAL_AVERAGEPOOL_INT8
	depends on THEAD_RVV_SOURCE
	bool "Layer global_averagepool int8"
	default y
	help
		Select SHL build v extension optimized global_averagepool

config THEAD_RVV_GLOBAL_MAXPOOL_FP32
	depends on THEAD_RVV_SOURCE
	bool "Layer global_maxpool fp32"
	default y
	help
		Select SHL build v extension optimized global_maxpool

config THEAD_RVV_GLOBAL_MAXPOOL_FP16
	depends on THEAD_RVV_SOURCE
	bool "Layer global_maxpool fp16"
	default y
	help
		Select SHL build v extension optimized global_maxpool

config THEAD_RVV_GLOBAL_MAXPOOL_INT8
	depends on THEAD_RVV_SOURCE
	bool "Layer global_maxpool int8"
	default y
	help
		Select SHL build v extension optimized global_maxpool

config THEAD_RVV_LAYER_NORM_FP32
	depends on THEAD_RVV_SOURCE
	bool "Layer layer_normal fp32"
	default y
	help
		Select SHL build v extension optimized layer_normal

config THEAD_RVV_LAYER_NORM_FP16
	depends on THEAD_RVV_SOURCE
	bool "Layer layer_normal fp16"
	default y
	help
		Select SHL build v extension optimized layer_normal

config THEAD_RVV_LAYER_NORM_INT8
	depends on THEAD_RVV_SOURCE
	bool "Layer layer_normal int8"
	default y
	help
		Select SHL build v extension optimized layer_normal

config THEAD_RVV_LEAKY_RELU_FP32
	depends on THEAD_RVV_SOURCE
	bool "Layer leaky_relu fp32"
	default y
	help
		Select SHL build v extension optimized leaky_relu

config THEAD_RVV_LEAKY_RELU_FP16
	depends on THEAD_RVV_SOURCE
	bool "Layer leaky_relu fp16"
	default y
	help
		Select SHL build v extension optimized leaky_relu

config THEAD_RVV_LEAKY_RELU_INT8
	depends on THEAD_RVV_SOURCE
	bool "Layer leaky_relu int8"
	default y
	help
		Select SHL build v extension optimized leaky_relu

config THEAD_RVV_MATMUL_INT8
	depends on THEAD_RVV_SOURCE
	bool "Layer matmul int8"
	default y
	help
		Select SHL build v extension optimized matmul

config THEAD_RVV_MAXPOOL_FP32
	depends on THEAD_RVV_SOURCE
	bool "Layer maxpool fp32"
	default y
	help
		Select SHL build v extension optimized maxpool

config THEAD_RVV_MAXPOOL_FP16
	depends on THEAD_RVV_SOURCE
	bool "Layer maxpool fp16"
	default y
	help
		Select SHL build v extension optimized maxpool

config THEAD_RVV_MAXPOOL_INT8
	depends on THEAD_RVV_SOURCE
	bool "Layer maxpool int8"
	default y
	help
		Select SHL build v extension optimized maxpool

config THEAD_RVV_MUL_FP32
	depends on THEAD_RVV_SOURCE
	bool "Layer mul fp32"
	default y
	help
		Select SHL build v extension optimized mul

config THEAD_RVV_MUL_FP16
	depends on THEAD_RVV_SOURCE
	bool "Layer mul fp16"
	default y
	help
		Select SHL build v extension optimized mul

config THEAD_RVV_MUL_INT8
	depends on THEAD_RVV_SOURCE
	bool "Layer mul int8"
	default y
	help
		Select SHL build v extension optimized mul

config THEAD_RVV_PAD_FP32
	depends on THEAD_RVV_SOURCE
	bool "Layer pad fp32"
	default y
	help
		Select SHL build v extension optimized pad

config THEAD_RVV_PAD_FP16
	depends on THEAD_RVV_SOURCE
	bool "Layer pad fp16"
	default y
	help
		Select SHL build v extension optimized pad

config THEAD_RVV_PAD_INT8
	depends on THEAD_RVV_SOURCE
	bool "Layer pad int8"
	default y
	help
		Select SHL build v extension optimized pad

config THEAD_RVV_PRELU_FP32
	depends on THEAD_RVV_SOURCE
	bool "Layer prelu fp32"
	default y
	help
		Select SHL build v extension optimized prelu

config THEAD_RVV_PRELU_FP16
	depends on THEAD_RVV_SOURCE
	bool "Layer prelu fp16"
	default y
	help
		Select SHL build v extension optimized prelu

config THEAD_RVV_PRELU_INT8
	depends on THEAD_RVV_SOURCE
	bool "Layer prelu int8"
	default y
	help
		Select SHL build v extension optimized prelu

config THEAD_RVV_RELU_FP32
	depends on THEAD_RVV_SOURCE
	bool "Layer relu fp32"
	default y
	help
		Select SHL build v extension optimized relu

config THEAD_RVV_RELU_FP16
	depends on THEAD_RVV_SOURCE
	bool "Layer relu fp16"
	default y
	help
		Select SHL build v extension optimized relu

config THEAD_RVV_RELU_INT8
	depends on THEAD_RVV_SOURCE
	bool "Layer relu int8"
	default y
	help
		Select SHL build v extension optimized relu

config THEAD_RVV_RELU6_FP32
	depends on THEAD_RVV_SOURCE
	bool "Layer relu6 fp32"
	default y
	help
		Select SHL build v extension optimized relu6

config THEAD_RVV_RELU6_FP16
	depends on THEAD_RVV_SOURCE
	bool "Layer relu6 fp16"
	default y
	help
		Select SHL build v extension optimized relu6

config THEAD_RVV_RESHAPE_FP32
	depends on THEAD_RVV_SOURCE
	bool "Layer reshape fp32"
	default y
	help
		Select SHL build v extension optimized reshape

config THEAD_RVV_RESHAPE_FP16
	depends on THEAD_RVV_SOURCE
	bool "Layer reshape fp16"
	default y
	help
		Select SHL build v extension optimized reshape

config THEAD_RVV_RESHAPE_INT8
	depends on THEAD_RVV_SOURCE
	bool "Layer reshape int8"
	default y
	help
		Select SHL build v extension optimized reshape

config THEAD_RVV_SIGMOID_FP16
	depends on THEAD_RVV_SOURCE
	bool "Layer sigmoid fp16"
	default y
	help
		Select SHL build v extension optimized sigmoid

config THEAD_RVV_SOFTMAX_FP32
	depends on THEAD_RVV_SOURCE
	bool "Layer softmax fp32"
	default y
	help
		Select SHL build v extension optimized softmax

config THEAD_RVV_SOFTMAX_FP16
	depends on THEAD_RVV_SOURCE
	bool "Layer softmax fp16"
	default y
	help
		Select SHL build v extension optimized softmax

config THEAD_RVV_SUM_INT8
	depends on THEAD_RVV_SOURCE
	bool "Layer sum int8"
	default y
	help
		Select SHL build v extension optimized sum

config THEAD_RVV_TRANSPOSE_FP16
	depends on THEAD_RVV_SOURCE
	bool "Layer transpose fp16"
	default y
	help
		Select SHL build v extension optimized transpose

config THEAD_RVV_TRANSPOSE_INT8
	depends on THEAD_RVV_SOURCE
	bool "Layer transpose int8"
	default y
	help
		Select SHL build v extension optimized transpose

config THEAD_RVV_GATHER_INT8
	depends on THEAD_RVV_SOURCE
	bool "Layer gather int8"
	default y
	help
		Select SHL build v extension optimized gather

endmenu
```
