## source/c920_opt/Kconfig
```kconfig
menu "C920 optimization"

config C920_SOURCE
	bool "SHL C920 optimization code"
	default y
	help
		Select SHL build C920 optimization

config C920_CONVOLUTION_FP32
	depends on C920_SOURCE
	bool "Layer convolution fp32"
	default y
	help
		Select SHL build v extension optimized convolution

config C920_CONVOLUTION_FP16
	depends on C920_SOURCE
	bool "Layer convolution fp16"
	default y
	help
		Select SHL build v extension optimized convolution

config C920_GEMM_FP32
	depends on C920_SOURCE
	bool "Layer GEMM fp32"
	default y
	help
		Select SHL build v extension optimized gemm

config C920_GEMM_FP16
	depends on C920_SOURCE
	bool "Layer GEMM fp16"
	default y
	help
		Select SHL build v extension optimized gemm

config C920_FULLYCONNECTED_FP32
	depends on C920_SOURCE
	bool "Layer fullyconnected fp32"
	default y
	help
		Select SHL build v extension optimized fullyconnected

config C920_FULLYCONNECTED_FP16
	depends on C920_SOURCE
	bool "Layer fullyconnected fp16"
	default y
	help
		Select SHL build v extension optimized fullyconnected

config C920_MATMUL_FP32
	depends on C920_SOURCE
	bool "Layer matmul fp32"
	default y
	help
		Select SHL build v extension optimized matmul

config C920_MATMUL_FP16
	depends on C920_SOURCE
	bool "Layer matmul fp16"
	default y
	help
		Select SHL build v extension optimized matmul

endmenu
```

## source/c920v2_opt/Kconfig
```kconfig
menu "C920V2 optimization"

config C920V2_SOURCE
	bool "SHL C920V2 optimization code"
	default y
	help
		Select SHL build C920V2 optimization

config C920V2_CONVOLUTION_FP32
	depends on C920V2_SOURCE
	bool "Layer convolution fp32"
	default y
	help
		Select SHL build v extension optimized convolution

config C920V2_CONVOLUTION_FP16
	depends on C920V2_SOURCE
	bool "Layer convolution fp16"
	default y
	help
		Select SHL build v extension optimized convolution

config C920V2_CONVOLUTION_INT8
	depends on C920V2_SOURCE
	bool "Layer convolution int8"
	default y
	help
		Select SHL build v extension optimized convolution

config C920V2_GEMM_FP32
	depends on C920V2_SOURCE
	bool "Layer GEMM fp32"
	default y
	help
		Select SHL build v extension optimized gemm

config C920V2_GEMM_FP16
	depends on C920V2_SOURCE
	bool "Layer GEMM fp16"
	default y
	help
		Select SHL build v extension optimized gemm

config C920V2_GEMM_INT8
	depends on C920V2_SOURCE
	bool "Layer GEMM fp16"
	default y
	help
		Select SHL build v extension optimized gemm

endmenu
```

## source/e907_opt/Kconfig
```kconfig
menu "E907 Optimization"

config E907_OPT_SOURCE
	depends on BUILD_RISCV_ELF_E907
	bool "SHL Optimization for E907"
	default y
	help
		Select SHL build E907 Optimization

config E907_OPT_CONVOLUTION
	depends on E907_OPT_SOURCE
	bool "Layer conv2d"
	default y
	help
		Select SHL build e907 opt conv2d

config E907_OPT_CONCAT
	depends on E907_OPT_SOURCE
	bool "Layer concat"
	default y
	help
		Select SHL build e907 opt concat

config E907_OPT_RELU
	depends on E907_OPT_SOURCE
	bool "Layer relu"
	default y
	help
		Select SHL build e907 opt relu

config E907_OPT_FC
	depends on E907_OPT_SOURCE
	bool "Layer fc"
	default y
	help
		Select SHL build e907 opt fc

config E907_OPT_MUL
	depends on E907_OPT_SOURCE
	bool "Layer mul"
	default y
	help
		Select SHL build e907 opt mul

config E907_OPT_SUM
	depends on E907_OPT_SOURCE
	bool "Layer sum"
	default y
	help
		Select SHL build e907 opt sum

config E907_OPT_SOFTMAX
	depends on E907_OPT_SOURCE
	bool "Layer softmax"
	default y
	help
		Select SHL build e907 opt softmax

endmenu
```
