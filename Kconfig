## Kconfig
```kconfig
mainmenu "SHL Configuration"

choice
	prompt "Build target"
	default BUILD_X86

config BUILD_X86
	bool "x86"
	help
	  Build x86 reference library

config BUILD_RISCV
	bool "riscv"
	help
	  Build RISC-V library

config BUILD_RISCV_ELF
	bool "riscv elf"
	help
	  Build RISC-V Elf library

config BUILD_CSKY
	bool "csky"
	help
	  Build C-SKY library

config BUILD_CSKY_ELF
	bool "csky elf"
	help
	  Build C-SKY elf library

endchoice


choice
	prompt "x86 platform"
    depends on BUILD_X86
	default BUILD_X86_REF

config BUILD_X86_REF
	bool "x86_ref"
	help
	  Build x86 c reference library

config BUILD_X86_PNNA
	bool "x86_pnna"
	help
	  Build pnna x86 simulate so

config BUILD_X86_HLIGHT
	bool "x86_hlight"
	help
      Build heterogeneous pnna x86 simulate so

endchoice

choice
	prompt "RISC-V platform"
    depends on BUILD_RISCV
	default BUILD_RISCV_RVV

config BUILD_RISCV_RVV
	bool "RISC-V V"
	help
	    Build RISC-V V common library

config BUILD_RISCV_C906_STATIC
	bool "C906 static"
	help
	    Build C906 V static library

config BUILD_RISCV_C906_SHARE
    bool "C906 share"
    help
        Build C906 V share library

config BUILD_RISCV_RVM
    bool "RVM"
    help
        Build RISC-V vector and matrix static library

config BUILD_RISCV_C908
    bool "C908"
    help
        Build C908 V static library

config BUILD_RISCV_C920
    bool "C920"
    help
        Build C920 V static library

config BUILD_RISCV_C920V2
    bool "C920V2"
    help
        Build C920V2 V static library

config BUILD_RISCV_PNNA
    bool "pnna"
    help
        Build pnna so

config BUILD_RISCV_HLIGHT
    bool "hlight"
    help
        Build heterogeneous pnna so

endchoice

choice
	prompt "RISC-V elf platform"
    depends on BUILD_RISCV_ELF
	default BUILD_RISCV_ELF_C906

config BUILD_RISCV_ELF_C906
	bool "C906 elf"
	help
	    Build C906 V static library

config BUILD_RISCV_ELF_E907
	bool "e907 elf"
	help
		Build E907 P extend static library

endchoice

choice
	prompt "C-SKY platform"
    depends on BUILD_CSKY
	default BUILD_CSKY_OPENVX

config BUILD_CSKY_OPENVX
	bool "openvx"
	help
	    Build openvx library

endchoice

config CUSTOM_SOURCE_SELECT
	bool
	default y

source "source/reference/Kconfig"
source "source/graph_ref/Kconfig"
source "source/thead_rvv/Kconfig"
source "source/c906_opt/Kconfig"
source "source/c908_opt/Kconfig"
source "source/e907_opt/Kconfig"
source "source/c920_opt/Kconfig"
source "source/c920v2_opt/Kconfig"

menu "Debug and profile Options"

config USE_SHL_DEBUG
    bool "SHL debug and log module"
    help
        Select SHL debug and log module

config SHL_LAYER_BENCHMARK
    bool "Layer information and performance"
    help
        Print the execution time of each layer

config USE_COMPILER_PATH
	bool "Custom compiler path"
	help
		Set this option if you have a custom compiler which needed to
		be define in CMAKE_C_COMPILER.

config CMAKE_C_COMPILER
	string "Path to c compiler"
	default "riscv64-unknown-linux-gnu-gcc"
	depends on USE_COMPILER_PATH
	help
		Path to the c compiler to be used instead of the one define by the
		board.

config CMAKE_CXX_COMPILER
		string "Path to cxx compiler"
		default "riscv64-unknown-linux-gnu-g++"
		depends on USE_COMPILER_PATH
		help
		Path to the cxx compiler to be used instead of the one define by the
		board.

config CMAKE_ASM_COMPILER
		string "Path to asm compiler"
		default "riscv64-unknown-linux-gnu-gcc"
		depends on USE_COMPILER_PATH
		help
		Path to the asm compiler to be used instead of the one define by the
		board.
endmenu
```

## source/c906_opt/Kconfig
```kconfig
menu "C906 optimization"

config C906_SOURCE
	bool "SHL C906 optimization code"
	default y
	help
		Select SHL build C906 optimization

config C906_ABS_FP32
	depends on C906_SOURCE
	bool "Layer abs fp32"
	default y
	help
		Select SHL build v extension optimized abs

config C906_ABS_FP16
	depends on C906_SOURCE
	bool "Layer abs fp16"
	default y
	help
		Select SHL build v extension optimized abs

config C906_ADD_FP32
	depends on C906_SOURCE
	bool "Layer add fp32"
	default y
	help
		Select SHL build v extension optimized add

config C906_ADD_FP16
	depends on C906_SOURCE
	bool "Layer add fp16"
	default y
	help
		Select SHL build v extension optimized add

config C906_AVERAGEPOOL_FP32
	depends on C906_SOURCE
	bool "Layer averagepool fp32"
	default y
	help
		Select SHL build v extension optimized averagepool

config C906_AVERAGEPOOL_FP16
	depends on C906_SOURCE
	bool "Layer averagepool fp16"
	default y
	help
		Select SHL build v extension optimized averagepool

config C906_CLIP_FP32
	depends on C906_SOURCE
	bool "Layer clip fp32"
	default y
	help
		Select SHL build v extension optimized clip

config C906_CLIP_FP16
	depends on C906_SOURCE
	bool "Layer clip fp16"
	default y
	help
		Select SHL build v extension optimized clip

config C906_CACHE_CONV1D_FP16
	depends on C906_SOURCE
	bool "Layer cache conv1d fp16"
	default y
	help
		Select SHL build v extension optimized cache conv1d

config C906_CACHE_MATMUL_FP16
	depends on C906_SOURCE
	bool "Layer cache matmul fp16"
	default y
	help
		Select SHL build v extension optimized cache matmul

config C906_CONCAT_FP32
	depends on C906_SOURCE
	bool "Layer concat fp32"
	default y
	help
		Select SHL build v extension optimized concat

config C906_CONCAT_FP16
	depends on C906_SOURCE
	bool "Layer concat fp16"
	default y
	help
		Select SHL build v extension optimized concat

config C906_CONVOLUTION_FP32
	depends on C906_SOURCE
	bool "Layer convolution fp32"
	default y
	help
		Select SHL build v extension optimized convolution

config C906_CONVOLUTION_FP16
	depends on C906_SOURCE
	bool "Layer convolution fp16"
	default y
	help
		Select SHL build v extension optimized convolution

config C906_DEPTHWISE_CONVOLUTION_FP32
	depends on C906_SOURCE
	bool "Layer depthwise convolution fp32"
	default y
	help
		Select SHL build v extension optimized convolution

config C906_DEPTHWISE_CONVOLUTION_FP16
	depends on C906_SOURCE
	bool "Layer depthwise convolution fp16"
	default y
	help
		Select SHL build v extension optimized convolution

config C906_CONVOLUTION1D_FP32
	depends on C906_SOURCE
	bool "Layer convolution1d fp32"
	default y
	help
		Select SHL build v extension optimized convolution1d

config C906_CONVOLUTION1D_FP16
	depends on C906_SOURCE
	bool "Layer convolution1d fp16"
	default y
	help
		Select SHL build v extension optimized convolution1d

config C906_DEPTHWISE_CONVOLUTION1D_FP16
	depends on C906_SOURCE
	bool "Layer depthwise convolution1d fp16"
	default y
	help
		Select SHL build v extension optimized convolution1d

config C906_DIV_FP32
	depends on C906_SOURCE
	bool "Layer div fp32"
	default y
	help
		Select SHL build v extension optimized convolution1d

config C906_DIV_FP16
	depends on C906_SOURCE
	bool "Layer div fp16"
	default y
	help
		Select SHL build v extension optimized convolution1d

config C906_FULLYCONNECTED_FP16
	depends on C906_SOURCE
	bool "Layer fullyconnected fp16"
	default y
	help
		Select SHL build v extension optimized fullyconnected

config C906_GEMM_FP32
	depends on C906_SOURCE
	bool "Layer GEMM fp32"
	default y
	help
		Select SHL build v extension optimized fullyconnected

config C906_GEMM_FP16
	depends on C906_SOURCE
	bool "Layer GEMM fp16"
	default y
	help
		Select SHL build v extension optimized fullyconnected

config C906_GEMV_FP16
	depends on C906_SOURCE
	bool "Layer GEMV fp16"
	default y
	help
		Select SHL build v extension optimized fullyconnected

config C906_GLOBAL_AVERAGEPOOL_FP32
	depends on C906_SOURCE
	bool "Layer global_averagepool fp32"
	default y
	help
		Select SHL build v extension optimized global_averagepool

config C906_GLOBAL_AVERAGEPOOL_FP16
	depends on C906_SOURCE
	bool "Layer global_averagepool fp16"
	default y
	help
		Select SHL build v extension optimized global_averagepool

config C906_GLOBAL_MAXPOOL_FP32
	depends on C906_SOURCE
	bool "Layer global_maxpool fp32"
	default y
	help
		Select SHL build v extension optimized global_maxpool

config C906_GLOBAL_MAXPOOL_FP16
	depends on C906_SOURCE
	bool "Layer global_maxpool fp16"
	default y
	help
		Select SHL build v extension optimized global_maxpool

config C906_LEAKY_RELU_FP32
	depends on C906_SOURCE
	bool "Layer leaky_relu fp32"
	default y
	help
		Select SHL build v extension optimized leaky_relu

config C906_LEAKY_RELU_FP16
	depends on C906_SOURCE
	bool "Layer leaky_relu fp16"
	default y
	help
		Select SHL build v extension optimized leaky_relu

config C906_LRN_FP16
	depends on C906_SOURCE
	bool "Layer lRN fp16"
	default y
	help
		Select SHL build v extension optimized LRN

config C906_MATMUL_FP16
	depends on C906_SOURCE
	bool "Layer matmul fp16"
	default y
	help
		Select SHL build v extension optimized matmul

config C906_MAXPOOL_FP32
	depends on C906_SOURCE
	bool "Layer maxpool fp32"
	default y
	help
		Select SHL build v extension optimized maxpool

config C906_MAXPOOL_FP16
	depends on C906_SOURCE
	bool "Layer maxpool fp16"
	default y
	help
		Select SHL build v extension optimized maxpool

config C906_MINIMUM_FP32
	depends on C906_SOURCE
	bool "Layer minimum fp32"
	default y
	help
		Select SHL build v extension optimized minimum

config C906_MINIMUM_FP16
	depends on C906_SOURCE
	bool "Layer minimum fp16"
	default y
	help
		Select SHL build v extension optimized minimum

config C906_MUL_FP32
	depends on C906_SOURCE
	bool "Layer mul fp32"
	default y
	help
		Select SHL build v extension optimized mul

config C906_MUL_FP16
	depends on C906_SOURCE
	bool "Layer mul fp16"
	default y
	help
		Select SHL build v extension optimized mul

config C906_PAD_FP32
	depends on C906_SOURCE
	bool "Layer pad fp32"
	default y
	help
		Select SHL build v extension optimized pad

config C906_PAD_FP16
	depends on C906_SOURCE
	bool "Layer pad fp16"
	default y
	help
		Select SHL build v extension optimized pad

config C906_PRELU_FP32
	depends on C906_SOURCE
	bool "Layer prelu fp32"
	default y
	help
		Select SHL build v extension optimized prelu

config C906_PRELU_FP16
	depends on C906_SOURCE
	bool "Layer prelu fp16"
	default y
	help
		Select SHL build v extension optimized prelu

config C906_RELU_FP32
	depends on C906_SOURCE
	bool "Layer relu fp32"
	default y
	help
		Select SHL build v extension optimized relu

config C906_RELU_FP16
	depends on C906_SOURCE
	bool "Layer relu fp16"
	default y
	help
		Select SHL build v extension optimized relu

config C906_RELU1_FP32
	depends on C906_SOURCE
	bool "Layer relu1 fp32"
	default y
	help
		Select SHL build v extension optimized relu

config C906_RELU1_FP16
	depends on C906_SOURCE
	bool "Layer relu1 fp16"
	default y
	help
		Select SHL build v extension optimized relu

config C906_RELU6_FP32
	depends on C906_SOURCE
	bool "Layer relu6 fp32"
	default y
	help
		Select SHL build v extension optimized relu6

config C906_RELU6_FP16
	depends on C906_SOURCE
	bool "Layer relu6 fp16"
	default y
	help
		Select SHL build v extension optimized relu6

config C906_RESHAPE_FP16
	depends on C906_SOURCE
	bool "Layer reshape fp16"
	default y
	help
		Select SHL build v extension optimized reshape

config C906_SPLIT_FP32
	depends on C906_SOURCE
	bool "Layer split fp32"
	default y
	help
		Select SHL build v extension optimized split

config C906_SPLIT_FP16
	depends on C906_SOURCE
	bool "Layer split fp16"
	default y
	help
		Select SHL build v extension optimized split

config C906_REDUCE_SUM_FP16
	depends on C906_SOURCE
	bool "Layer reduce_sum fp16"
	default y
	help
		Select SHL build v extension optimized reduce_sum

config C906_SUB_FP32
	depends on C906_SOURCE
	bool "Layer sub fp32"
	default y
	help
		Select SHL build v extension optimized sub

config C906_SUB_FP16
	depends on C906_SOURCE
	bool "Layer sub fp16"
	default y
	help
		Select SHL build v extension optimized sub

endmenu
```

## source/c908_opt/Kconfig
```kconfig
menu "C908 optimization"

config C908_SOURCE
	bool "SHL C908 optimization code"
	default y
	help
		Select SHL build C908 optimization

config C908_AVERAGEPOOL_FP32
	depends on C908_SOURCE
	bool "Layer avgpool fp32"
	default y
	help
		Select SHL build v extension optimized avgpool

config C908_AVERAGEPOOL_FP16
	depends on C908_SOURCE
	bool "Layer avgpool fp16"
	default y
	help
		Select SHL build v extension optimized avgpool

config C908_AVERAGEPOOL_INT8
	depends on C908_SOURCE
	bool "Layer avgpool int8"
	default y
	help
		Select SHL build v extension optimized avgpool

config C908_CONVOLUTION_FP32
	depends on C908_SOURCE
	bool "Layer convolution fp32"
	default y
	help
		Select SHL build v extension optimized convolution

config C908_CONVOLUTION_FP16
	depends on C908_SOURCE
	bool "Layer convolution fp16"
	default y
	help
		Select SHL build v extension optimized convolution

config C908_CONVOLUTION_INT8
	depends on C908_SOURCE
	bool "Layer convolution int8"
	default y
	help
		Select SHL build v extension optimized convolution

config C908_CONVOLUTION_INT4
	depends on C908_SOURCE
	bool "Layer convolution int4"
	default y
	help
		Select SHL build v extension optimized convolution

config C908_DEPTHWISE_CONVOLUTION_FP32
	depends on C908_SOURCE
	bool "Layer depthwise convolution fp32"
	default y
	help
		Select SHL build v extension optimized depthwise convolution

config C908_DEPTHWISE_CONVOLUTION_FP16
	depends on C908_SOURCE
	bool "Layer depthwise convolution fp16"
	default y
	help
		Select SHL build v extension optimized depthwise convolution

config C908_DEPTHWISE_CONVOLUTION_INT8
	depends on C908_SOURCE
	bool "Layer depthwise convolution int8"
	default y
	help
		Select SHL build v extension optimized depthwise convolution

config C908_DEPTHWISE_CONVOLUTION_INT4
	depends on C908_SOURCE
	bool "Layer depthwise convolution int4"
	default y
	help
		Select SHL build v extension optimized depthwise convolution

config C908_FULLYCONNECTED_FP32
	depends on C908_SOURCE
	bool "Layer fullyconnected fp32"
	default y
	help
		Select SHL build v extension optimized fullyconnected

config C908_FULLYCONNECTED_FP16
	depends on C908_SOURCE
	bool "Layer fullyconnected fp16"
	default y
	help
		Select SHL build v extension optimized fullyconnected

config C908_FULLYCONNECTED_INT8
	depends on C908_SOURCE
	bool "Layer fullyconnected int8"
	default y
	help
		Select SHL build v extension optimized fullyconnected

config C908_FULLYCONNECTED_INT4
	depends on C908_SOURCE
	bool "Layer fullyconnected int4"
	default y
	help
		Select SHL build v extension optimized fullyconnected

config C908_GEMM_FP32
	depends on C908_SOURCE
	bool "Layer GEMM fp32"
	default y
	help
		Select SHL build v extension optimized gemm

config C908_GEMM_FP16
	depends on C908_SOURCE
	bool "Layer GEMM fp16"
	default y
	help
		Select SHL build v extension optimized gemm

config C908_GEMM_INT8
	depends on C908_SOURCE
	bool "Layer GEMM int8"
	default y
	help
		Select SHL build v extension optimized gemm

config C908_GEMM_INT4
	depends on C908_SOURCE
	bool "Layer GEMM int4"
	default y
	help
		Select SHL build v extension optimized gemm

config C908_MAXPOOL_FP32
	depends on C908_SOURCE
	bool "Layer maxpool fp32"
	default y
	help
		Select SHL build v extension optimized maxpool

config C908_MAXPOOL_FP16
	depends on C908_SOURCE
	bool "Layer maxpool fp16"
	default y
	help
		Select SHL build v extension optimized maxpool

config C908_MAXPOOL_INT8
	depends on C908_SOURCE
	bool "Layer maxpool int8"
	default y
	help
		Select SHL build v extension optimized maxpool

endmenu
```
